## Kconfig
```kconfig
choice
    prompt "Platform"

    config PLATFORM_HOST
        bool "Host"
        select HAVE_HOST_UART

    config PLATFORM_RASPI3B
        bool "Raspberry pi 3B"
        select ARCH_AARCH64
        select HAVE_BCM2837_MBOX
        select HAVE_BCM2837_UART1
endchoice

rsource "arch/Kconfig"
rsource "drivers/Kconfig"
```

## drivers/bcm2837_mbox/Kconfig
```kconfig
config HAVE_BCM2837_MBOX
    bool

config BCM2837_MBOX
    bool "BCM2837 mailbox"
    depends on HAVE_BCM2837_MBOX

config BCM2837_MBOX_SIZE
    int "Mailbox message pool size"
    default "32"
    depends on BCM2837_MBOX
```

## drivers/mbox/Kconfig
```kconfig
config HAVE_BCM2837_MBOX
    bool

config BCM2837_MBOX
    bool "BCM2837 mailbox"
    depends on HAVE_BCM2837_MBOX
```

## drivers/uart/Kconfig
```kconfig
config HAVE_HOST_UART
    bool
config HAVE_BCM2837_UART0
    bool
config HAVE_BCM2837_UART1
    bool
config UART
    bool
    default HOST_UART || BCM2837_UART1

choice
    prompt "UART"
    optional

    config HOST_UART
        bool "Host"
        depends on HAVE_HOST_UART
        help
            Standard library putchar() implementation

    config BCM2837_UART0
        bool "BCM2837 UART0"
        depends on HAVE_BCM2837_UART0 && BCM2837_MBOX
        help
            BCM2837 UART0

    config BCM2837_UART1
        bool "BCM2837 UART1"
        depends on HAVE_BCM2837_UART1
        help
           BCM2837 auxiliary mini UART1 on GPIO14 and GPIO15
endchoice
```
